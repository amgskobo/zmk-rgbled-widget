## Kconfig
```kconfig
# Color definitions to use with color settings
COLOR_BLACK   := 0
COLOR_RED     := 1
COLOR_GREEN   := 2
COLOR_YELLOW  := 3
COLOR_BLUE    := 4
COLOR_MAGENTA := 5
COLOR_CYAN    := 6
COLOR_WHITE   := 7

config RGBLED_WIDGET
    bool "Enable RGB LED widget for showing battery and output status"

if RGBLED_WIDGET

config LED
    default y

config RGBLED_WIDGET_INTERVAL_MS
    int "Minimum wait duration between two blinks in ms"
    default 500

# Battery level settings

config RGBLED_WIDGET_SHOW_BATTERY_STATUS
    bool "Show battery status indications, including boot and critical battery"
    default y

choice RGBLED_WIDGET_BATTERY_SHOW
    prompt "Which battery levels to indicate, non-defaults only work for split centrals"

config RGBLED_WIDGET_BATTERY_SHOW_SELF
    bool "Indicate battery level from self only"

config RGBLED_WIDGET_BATTERY_SHOW_PERIPHERALS
    bool "Indicate battery levels from self and peripherals (if split central)"
    depends on (ZMK_SPLIT && ZMK_SPLIT_ROLE_CENTRAL)
    select ZMK_SPLIT_BLE_CENTRAL_BATTERY_LEVEL_FETCHING

config RGBLED_WIDGET_BATTERY_SHOW_ONLY_PERIPHERALS
    bool "Indicate battery levels from peripherals only (if split central)"
    depends on (ZMK_SPLIT && ZMK_SPLIT_ROLE_CENTRAL)
    select ZMK_SPLIT_BLE_CENTRAL_BATTERY_LEVEL_FETCHING

endchoice

config RGBLED_WIDGET_BATTERY_BLINK_MS
    int "Duration of battery level blink in ms"
    default 2000

config RGBLED_WIDGET_BATTERY_LEVEL_HIGH
    int "High battery level percentage"
    default 80

config RGBLED_WIDGET_BATTERY_LEVEL_LOW
    int "Low battery level percentage"
    default 20

config RGBLED_WIDGET_BATTERY_LEVEL_CRITICAL
    int "Critical battery level percentage"
    default 5

config RGBLED_WIDGET_BATTERY_COLOR_HIGH
    int "Color for high battery level (above LEVEL_HIGH)"
    range 0 7
    default $(COLOR_GREEN)

config RGBLED_WIDGET_BATTERY_COLOR_MEDIUM
    int "Color for medium battery level (between LEVEL_LOW and LEVEL_HIGH)"
    range 0 7
    default $(COLOR_YELLOW)

config RGBLED_WIDGET_BATTERY_COLOR_LOW
    int "Color for low battery level (below LEVEL_LOW)"
    range 0 7
    default $(COLOR_RED)

config RGBLED_WIDGET_BATTERY_COLOR_CRITICAL
    int "Color for critical battery level (below LEVEL_CRITICAL)"
    range 0 7
    default $(COLOR_RED)

config RGBLED_WIDGET_BATTERY_COLOR_MISSING
    int "Color for battery not detected, or peripheral disconnected"
    range 0 7
    default $(COLOR_MAGENTA)

# Connectivity indicator settings
config RGBLED_WIDGET_SHOW_CONNECTION_STATUS
    bool "Show connection status indications"
    default y

config RGBLED_WIDGET_CONN_BLINK_MS
    int "Duration of BLE connection status blink in ms"
    default RGBLED_WIDGET_OUTPUT_BLINK_MS

config RGBLED_WIDGET_CONN_SHOW_USB
    bool "Show USB indicator instead of BLE status if it has priority"

config RGBLED_WIDGET_OUTPUT_BLINK_MS  # DEPRECATED, do not use
    int
    default 1000

config RGBLED_WIDGET_CONN_COLOR_CONNECTED
    int "Color for connected BLE connection status"
    range 0 7
    default $(COLOR_BLUE)

config RGBLED_WIDGET_CONN_COLOR_ADVERTISING
    int "Color for advertising BLE connection status"
    range 0 7
    default $(COLOR_YELLOW)

config RGBLED_WIDGET_CONN_COLOR_DISCONNECTED
    int "Color for disconnected BLE connection status"
    range 0 7
    default $(COLOR_RED)

config RGBLED_WIDGET_CONN_COLOR_USB
    int "Color for USB endpoint active"
    range 0 7
    default $(COLOR_CYAN)

# Layer indicator settings
config RGBLED_WIDGET_SHOW_LAYER_CHANGE
    bool "Indicate highest active layer on each layer change with a sequence of blinks"

config RGBLED_WIDGET_LAYER_SINGLE_PULSE
    bool "Show one layer-colored pulse instead of counting the layer index"
    depends on RGBLED_WIDGET_SHOW_LAYER_CHANGE && !RGBLED_WIDGET_SHOW_LAYER_COLORS
    default n
    help
      Show the selected layer's configured color once, then turn it off.
      Layer 0 is included. Queued pulses for an obsolete layer are discarded.
      This mode does not light up at boot or on wake without a layer change.

config RGBLED_WIDGET_LAYER_BLINK_MS
    int "Blink and wait duration for layer indicator"
    default 100

config RGBLED_WIDGET_LAYER_IGNORE_MASK
    hex "Stable layer IDs excluded from the single-pulse indicator"
    depends on RGBLED_WIDGET_LAYER_SINGLE_PULSE
    range 0x0 0xffffffff
    default 0x0
    help
      Bit N excludes stable layer ID N from the single-pulse display.
      Select the highest active non-excluded layer, so entering or leaving an
      automatic mouse layer alone causes no pulse. Normal layer changes below
      an excluded layer still appear. An empty eligible set produces no pulse.

config RGBLED_WIDGET_LAYER_COLOR
    int "Color to use for layer indicator"
    range 0 7
    default $(COLOR_CYAN)

config RGBLED_WIDGET_LAYER_DEBOUNCE_MS
    int "Wait duration after a layer change before showing the highest active layer"
    default 100

# Constant layer color settings
config RGBLED_WIDGET_SHOW_LAYER_COLORS
    bool "Use custom colors for layers"

config RGBLED_WIDGET_LAYER_0_COLOR
    int "Color to use for the base layer"
    range 0 7
    default $(COLOR_BLACK)

config RGBLED_WIDGET_LAYER_1_COLOR
    int "Color to use for layer 1"
    range 0 7
    default $(COLOR_RED)

config RGBLED_WIDGET_LAYER_2_COLOR
    int "Color to use for layer 2"
    range 0 7
    default $(COLOR_GREEN)

config RGBLED_WIDGET_LAYER_3_COLOR
    int "Color to use for layer 3"
    range 0 7
    default $(COLOR_YELLOW)

config RGBLED_WIDGET_LAYER_4_COLOR
    int "Color to use for layer 4"
    range 0 7
    default $(COLOR_BLUE)

config RGBLED_WIDGET_LAYER_5_COLOR
    int "Color to use for layer 5"
    range 0 7
    default $(COLOR_MAGENTA)

config RGBLED_WIDGET_LAYER_6_COLOR
    int "Color to use for layer 6"
    range 0 7
    default $(COLOR_CYAN)

config RGBLED_WIDGET_LAYER_7_COLOR
    int "Color to use for layer 7"
    range 0 7
    default $(COLOR_WHITE)

config RGBLED_WIDGET_LAYER_8_COLOR
    int "Color to use for layer 8"
    range 0 7
    default $(COLOR_BLACK)

config RGBLED_WIDGET_LAYER_9_COLOR
    int "Color to use for layer 9"
    range 0 7
    default $(COLOR_BLACK)

config RGBLED_WIDGET_LAYER_10_COLOR
    int "Color to use for layer 10"
    range 0 7
    default $(COLOR_BLACK)

config RGBLED_WIDGET_LAYER_11_COLOR
    int "Color to use for layer 11"
    range 0 7
    default $(COLOR_BLACK)

config RGBLED_WIDGET_LAYER_12_COLOR
    int "Color to use for layer 12"
    range 0 7
    default $(COLOR_BLACK)

config RGBLED_WIDGET_LAYER_13_COLOR
    int "Color to use for layer 13"
    range 0 7
    default $(COLOR_BLACK)

config RGBLED_WIDGET_LAYER_14_COLOR
    int "Color to use for layer 14"
    range 0 7
    default $(COLOR_BLACK)

config RGBLED_WIDGET_LAYER_15_COLOR
    int "Color to use for layer 15"
    range 0 7
    default $(COLOR_BLACK)

config RGBLED_WIDGET_LAYER_16_COLOR
    int "Color to use for layer 16"
    range 0 7
    default $(COLOR_BLACK)

config RGBLED_WIDGET_LAYER_17_COLOR
    int "Color to use for layer 17"
    range 0 7
    default $(COLOR_BLACK)

config RGBLED_WIDGET_LAYER_18_COLOR
    int "Color to use for layer 18"
    range 0 7
    default $(COLOR_BLACK)

config RGBLED_WIDGET_LAYER_19_COLOR
    int "Color to use for layer 19"
    range 0 7
    default $(COLOR_BLACK)

config RGBLED_WIDGET_LAYER_20_COLOR
    int "Color to use for layer 20"
    range 0 7
    default $(COLOR_BLACK)

config RGBLED_WIDGET_LAYER_21_COLOR
    int "Color to use for layer 21"
    range 0 7
    default $(COLOR_BLACK)

config RGBLED_WIDGET_LAYER_22_COLOR
    int "Color to use for layer 22"
    range 0 7
    default $(COLOR_BLACK)

config RGBLED_WIDGET_LAYER_23_COLOR
    int "Color to use for layer 23"
    range 0 7
    default $(COLOR_BLACK)

config RGBLED_WIDGET_LAYER_24_COLOR
    int "Color to use for layer 24"
    range 0 7
    default $(COLOR_BLACK)

config RGBLED_WIDGET_LAYER_25_COLOR
    int "Color to use for layer 25"
    range 0 7
    default $(COLOR_BLACK)

config RGBLED_WIDGET_LAYER_26_COLOR
    int "Color to use for layer 26"
    range 0 7
    default $(COLOR_BLACK)

config RGBLED_WIDGET_LAYER_27_COLOR
    int "Color to use for layer 27"
    range 0 7
    default $(COLOR_BLACK)

config RGBLED_WIDGET_LAYER_28_COLOR
    int "Color to use for layer 28"
    range 0 7
    default $(COLOR_BLACK)

config RGBLED_WIDGET_LAYER_29_COLOR
    int "Color to use for layer 29"
    range 0 7
    default $(COLOR_BLACK)

config RGBLED_WIDGET_LAYER_30_COLOR
    int "Color to use for layer 30"
    range 0 7
    default $(COLOR_BLACK)

config RGBLED_WIDGET_LAYER_31_COLOR
    int "Color to use for layer 31"
    range 0 7
    default $(COLOR_BLACK)

endif # RGBLED_WIDGET

DT_COMPAT_ZMK_BEHAVIOR_RGBLED_WIDGET := zmk,behavior-rgbled-widget

config ZMK_BEHAVIOR_RGBLED_WIDGET
    bool
    default $(dt_compat_enabled,$(DT_COMPAT_ZMK_BEHAVIOR_RGBLED_WIDGET))

config ZMK_RGBLED_WIDGET_LOG_LEVEL
    int "zmk-rgbled-widget log level (0 off, 1 error, 2 warning, 3 info, 4 debug)"
    range 0 4
    default 3
    help
      Logs contain operational state and numeric diagnostics, never input
      contents, user labels, peer addresses or authentication material.
```
